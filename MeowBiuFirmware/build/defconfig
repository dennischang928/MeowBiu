## MeowBiuFirmware/build/defconfig
```kconfig
CONFIG_ESPTOOLPY_FLASHSIZE_8MB=y
CONFIG_PARTITION_TABLE_SINGLE_APP_LARGE=y
CONFIG_LCD_ENABLE_DEBUG_LOG=y
CONFIG_ESP_SYSTEM_USE_FRAME_POINTER=y
CONFIG_FREERTOS_HZ=1000
CONFIG_LV_MEM_SIZE_KILOBYTES=48
CONFIG_LV_OS_FREERTOS=y
CONFIG_LV_DRAW_TRANSFORM_USE_MATRIX=y
CONFIG_LV_DRAW_LAYER_SIMPLE_BUF_SIZE=8192
CONFIG_LV_DRAW_LAYER_MAX_MEMORY=8192
CONFIG_LV_DRAW_THREAD_PRIO=4
CONFIG_LV_USE_LOG=y
CONFIG_LV_USE_MATRIX=y
CONFIG_LV_FONT_MONTSERRAT_18=y
CONFIG_LV_FONT_MONTSERRAT_20=y
CONFIG_LV_FONT_MONTSERRAT_24=y
CONFIG_LV_FONT_MONTSERRAT_48=y
CONFIG_LV_FONT_DEFAULT_MONTSERRAT_32=y
CONFIG_LV_USE_LODEPNG=y
CONFIG_LV_USE_GIF=y
CONFIG_LV_GIF_CACHE_DECODE_DATA=y
CONFIG_LV_BIN_DECODER_RAM_LOAD=y
CONFIG_LV_USE_RLE=y
CONFIG_LV_USE_LZ4=y
CONFIG_LV_USE_SYSMON=y
# CONFIG_LV_BUILD_EXAMPLES is not set
# CONFIG_LV_BUILD_DEMOS is not set
```
